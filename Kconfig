## Kconfig
```kconfig
mainmenu "Automotive Software AS Configuration"

config BOARD
    string
    option env="BOARD"
    default "posix"

config ANY
    string
    option env="ANY"
    default "none"

config RELEASE
    string
    option env="RELEASE"
    default "ascore"

config ASROOT
    string
    option env="ASROOT"
    default "../.."

source "$ASROOT/com/as.application/Kconfig"
source "$ASROOT/com/as.infrastructure/Kconfig"
source "$ASROOT/com/as.tool/Kconfig"
if !IS_ASTOOL
source "$ASROOT/release/$RELEASE/Kconfig"
endif
```

## com/as.application/board.any/aslib/Kconfig
```kconfig
config ARCH_ANY
    bool
    default y
    select DEFAULT_ANYOS
    select IS_ASTOOL

config ARCH
    string
    default "host"

config ASLIB
    bool
    default y

config DET
    bool
    default y
```

## com/as.application/board.any/lua/Kconfig
```kconfig
config ARCH_ANY
	bool
	default y
	select DEFAULT_ANYOS
	select IS_ASTOOL
	select LUA

config ARCH
	string
	default "host"


config DET
    bool
    default y

config SHELL
	bool
	default y

config ANYOS
	bool
	default y
```

## com/as.application/board.any/pyas/Kconfig
```kconfig
config ARCH_ANY
    bool
    default y
    select DEFAULT_ANYOS
    select IS_ASTOOL

config ARCH
    string
    default "host"

config PYAS
    bool
    default y
```

## com/as.application/board.stm32f107vc/Kconfig
```kconfig
config ARCH_STM31F1
    bool
    default y
    select DEFAULT_ASKAR

config DEMO_LED_APP
	bool "demo led application"
	default y
	depends on DIO

config ARCH
    string
    default "stm32f1"

choice
	prompt "USB demo application"
	default USB_CAN
	depends on USB

config USB_SERIAL
	bool "demo USB on serial application"

config USB_CAN
	bool "demo USB on CAN application"

endchoice
```

## com/as.infrastructure/Kconfig
```kconfig
if !IS_ASTOOL
source "$ASROOT/com/as.infrastructure/arch/Kconfig"
source "$ASROOT/com/as.infrastructure/communication/Kconfig"
source "$ASROOT/com/as.infrastructure/diagnostic/Kconfig"
source "$ASROOT/com/as.infrastructure/memory/Kconfig"
source "$ASROOT/com/as.infrastructure/system/Kconfig"
source "$ASROOT/com/as.infrastructure/clib/Kconfig"
source "$ASROOT/com/as.infrastructure/libraries/Kconfig"
source "$ASROOT/com/as.infrastructure/libraries/nn/Kconfig"
source "$ASROOT/com/as.infrastructure/boot/Kconfig"
endif
```

## com/as.infrastructure/boot/Kconfig
```kconfig
menu "bootloader config"

config BOOTLOADER
	bool "as demo bootloader"
	default y if RELEASE_ASBOOT

config MINIBLT
	bool "as mini bootloader"
	default n
	depends on BOOTLOADER

endmenu
```

## com/as.infrastructure/diagnostic/Kconfig
```kconfig
menu "AUTOSAR Diagnostic Stack"

config DCM
	bool "Diagnostic Communication Manager"
	depends on PDUR
	default y

config DCM_MINI
	bool "mini Diagnostic Communication Manager"
	depends on DCM
	default n

config DEM
	bool "Diagnostic Event Manager"
	depends on NVM
	default y

config DET
	bool "Development Error Trace"
	default y

endmenu
```

## com/as.infrastructure/libraries/Kconfig
```kconfig
menu "libraries"

config IFX
	bool "Interpolation Fixed point"
	default y

config FDT
	bool "flat device tree library"
	default n

config TRACE
	bool "enable the trace library"
	default n

config LIBFIXMATH
	bool "Cross Platform Fixed Point Maths Library"
	default y

endmenu
```

## com/as.infrastructure/libraries/nn/Kconfig
```kconfig
menu "AI libraries for Microcontrollers"

config ARMNN
	bool "enable ARM CMSIS NN library"
	default n

config NNOM
	bool "enable Neural Network on Microcontroller"
	default y
	depends on ARMNN

config KWS
	bool "Keyword spotting for Microcontrollers"
	default y
	depends on ARMNN

endmenu
```

## com/as.tool/lua/Kconfig
```kconfig
config LUA
	bool "LUA"
	depends on !PYAS
	default y

config LUA_ASLIB
	bool
	depends on LUA
	default y

config LUA_DEV
	bool "as device library"
	default y

config LUA_DEV_RS232
	bool "as rs232 device"
	depends on LUA_DEV
	default y

config LUA_CAN
	bool "as CAN library"
	default y

config LUA_SERIAL_CAN
	bool "as CAN on serial device"
	depends on LUA_CAN
	default y

config LUA_PEAK_CAN
	bool "as PEAK CAN device"
	depends on LUA_CAN
	default y

config LUA_ZLG_CAN
	bool "as ZLG CAN device"
	depends on LUA_CAN
	default y

config LUA_VXL_CAN
	bool "as VXL CAN device"
	depends on LUA_CAN
	default y

config LUA_SOCKET_CAN
	bool "as socket virtual CAN device"
	depends on LUA_CAN
	default y
```

## release/ascore/Kconfig
```kconfig
source "$ASROOT/release/ascore/SgDesign/Kconfig"
source "$ASROOT/release/ascore/elf/Kconfig"

config RELEASE_ASCORE
	bool
	default y
```
